## main/Kconfig.projbuild
```kconfig
menu "Configuration Options"
    config ESP_WIFI_CHANNEL
        int "WiFi Channel"
        range 1 13
        default 1
        help
            WiFi channel (network channel) for the example to use.

    config ESP_MAX_STA_CONN
        int "Maximal STA connections"
        default 4
        help
            Max number of the STA connects to AP.
    
    config SHUNT_RESISTOR_MILLI_OHM
        int "Shunt Resistor Value"
        range 1 100000
        default 100
        help
            Shunt resistor value in milli-ohm. This is used to calculate the current.

    config I2C_ADDR
        hex "I2C address of INA219"
        default 0x40
        help
            I2C address of INA219. The default is A1 pin to GND, and A0 pin to
            GND (`INA219_ADDR_GND_GND`, or `0x40`). See available options in
            ina219.h.

    config I2C_MASTER_SCL
        int "SCL GPIO Number"
        default 7 
        help
            GPIO number for I2C Master clock line.

    config I2C_MASTER_SDA
        int "SDA GPIO Number"
        default 6
        help
            GPIO number for I2C Master data line.
    
    config WEB_MOUNT_POINT
        string "Website mount point in VFS"
        default "/www"
        help
            Specify the mount point in VFS.

endmenu
```
